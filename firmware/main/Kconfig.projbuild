## firmware/main/Kconfig.projbuild
```kconfig
menu "CamBox"

    choice CAM_DRIVE
        prompt "Drive type"
        default CAM_DRIVE_MG90S
        help
            Which motor this box drives. Both build from the same firmware;
            only the motor output differs (servo.c or motor_drv8833.c).

        config CAM_DRIVE_MG90S
            bool "MG90S continuous servo"
        config CAM_DRIVE_N20
            bool "N20 gearmotor + DRV8833"
    endchoice

    choice CAM_BOARD
        prompt "Board"
        default CAM_BOARD_XIAO_C6
        help
            Which ESP32-C6 board is fitted. Only the pin map (main/board.h)
            and the antenna set-up differ.

        config CAM_BOARD_XIAO_C6
            bool "Seeed XIAO ESP32-C6"
        config CAM_BOARD_SUPERMINI_C6
            bool "ESP32-C6 Super Mini (26 x 18 mm, castellated)"
    endchoice

endmenu
```

## firmware/sdkconfig.defaults
```kconfig
CONFIG_IDF_TARGET="esp32c6"
CONFIG_ESPTOOLPY_FLASHSIZE_4MB=y
CONFIG_PARTITION_TABLE_CUSTOM=y
CONFIG_PARTITION_TABLE_CUSTOM_FILENAME="partitions.csv"
CONFIG_HTTPD_WS_SUPPORT=y
CONFIG_HTTPD_MAX_REQ_HDR_LEN=1024
CONFIG_HTTPD_MAX_URI_LEN=256
CONFIG_LWIP_MAX_SOCKETS=16
CONFIG_ESP_MAIN_TASK_STACK_SIZE=6144
CONFIG_LOG_DEFAULT_LEVEL_INFO=y
```
